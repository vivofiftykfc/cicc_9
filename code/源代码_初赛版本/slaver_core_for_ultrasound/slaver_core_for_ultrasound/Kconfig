## code/源代码_初赛版本/slaver_core_for_ultrasound/slaver_core_for_ultrasound/Kconfig
```kconfig
#
# For a description of the syntax of this configuration file,
# see tools/kconfiglib/kconfig-language.txt.
#


mainmenu "Phytium Baremetal Configuration"

	menu "Project Configuration"

		menu " Baremetal Configuration"
		config TARGET_NAME
			string "Build Target Name"
			default "openamp_core0"
			help
				Build Target name for the demo

	endmenu

endmenu


source "$(SDK_DIR)/standalone.kconfig"
```
